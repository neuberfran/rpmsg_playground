## CMakeLists.txt
```
cmake_minimum_required(VERSION 3.20.0)
set(EXTRA_ZEPHYR_MODULES ${CMAKE_CURRENT_LIST_DIR})

find_package(Zephyr REQUIRED HINTS $ENV{ZEPHYR_BASE})
project(cpu_app_rpmsg)

target_sources(app PRIVATE src/main.c)
```

## Kconfig
```
source "Kconfig.zephyr"

config INCLUDE_NET_CORE_IMAGE
    bool "Include net image as sub image"
	depends on SOC_NRF5340_CPUAPP
    default y
	select PARTITION_MANAGER_ENABLED
    select BOARD_ENABLE_CPUNET
```

## prj.conf
```kconfig
CONFIG_IPC_SERVICE=y
# CONFIG_BOOTLOADER_MCUBOOT=y

CONFIG_PRINTK=y
CONFIG_LOG=y
CONFIG_IPC_SERVICE_LOG_LEVEL_INF=y
#CONFIG_SENSOR_LOG_LEVEL_DBG=y
CONFIG_IPC_SERVICE_BACKEND_RPMSG=y
CONFIG_MBOX=y
#CONFIG_LOG_PROCESS_THREAD=y
# required to allocate virtqueues
CONFIG_HEAP_MEM_POOL_SIZE=4096
CONFIG_OPENAMP=y
CONFIG_OPENAMP_SLAVE=n

CONFIG_PARTITION_MANAGER_ENABLED=y

CONFIG_SHELL=n
CONFIG_SHELL_HISTORY=y
CONFIG_SHELL_VT100_COLORS=y
CONFIG_UART_CONSOLE=n
CONFIG_RTT_CONSOLE=y
CONFIG_USE_SEGGER_RTT=y
CONFIG_SHELL_BACKEND_RTT=y
CONFIG_SHELL_BACKEND_SERIAL=n

# Comentei isso logo acima pra test

# Config LOGGER
# CONFIG_LOG=y
# CONFIG_RTT_CONSOLE=y
# CONFIG_USE_SEGGER_RTT=y
# CONFIG_LOG_BACKEND_RTT=y
# CONFIG_LOG_MODE_IMMEDIATE=y
# CONFIG_NEWLIB_LIBC=y
# CONFIG_NEWLIB_LIBC_FLOAT_PRINTF=y
# CONFIG_CBPRINTF_FP_SUPPORT=y

#pus por cause do cdc_lah
# CONFIG_USB_CDC_ACM=y
# CONFIG_USB_CDC_ACM_LOG_LEVEL_ERR=y
# CONFIG_USB_DEVICE_LOG_LEVEL_ERR=y
# CONFIG_UART_LINE_CTRL=y
# CONFIG_SHELL_BACKEND_SERIAL_INIT_PRIORITY=51
# CONFIG_SHELL_BACKEND_SERIAL_CHECK_DTR=y

#CONFIG_UART_CONSOLE=n

# #AGORA VAI
# CONFIG_SERIAL=y
# CONFIG_CONSOLE=y
# CONFIG_UART_CONSOLE=n
#esses 3 Acima foram colocados agora
#CONFIG_BOARD_SERIAL_BACKEND_CDC_ACM=n

# CONFIG_BOOTLOADER_MCUBOOT=y
```

## boards/thingy53_nrf5340_cpuapp.conf
```kconfig
CONFIG_ASSERT=y
CONFIG_RESET_ON_FATAL_ERROR=n

CONFIG_LOG=y
CONFIG_LOG_MODE_DEFERRED=y
CONFIG_LOG_PROCESS_THREAD_STACK_SIZE=4096
CONFIG_LOG_PRINTK=y
CONFIG_LOG_BUFFER_SIZE=4096
```

## boards/thingy53_nrf5340_cpuapp.overlay
```dts
//  / {
//  	chosen {
//  		zephyr,console = &cdc_acm_uart0;
// 		};
// };

// &zephyr_udc0 {
// 	cdc_acm_uart0: cdc_acm_uart0 {
// 		compatible = "zephyr,cdc-acm-uart";
// 		label = "CDC_ACM_0";
//         status = "okay";
// 	};
// };

// / {
//     chosen {
//         zephyr,console = &cdc_acm_uart0;
//         zephyr,shell-uart = &cdc_acm_uart0;
//         zephyr,uart-mcumgr = &cdc_acm_uart0;
//     };
// };

// zephyr_udc0: &usbd {
//   compatible = "nordic,nrf-usbd";
//   status = "okay";
//   cdc_acm_uarto: cdc_acm_uarto {
//      compatible = "zephyr,cdc-acm-uart";
//      label = "CDC_ACM_0";
//   };
// };
```

## src/main.c
```c
#include <zephyr/kernel.h>
#include <zephyr/device.h>
#include <zephyr/logging/log.h>
#include <zephyr/ipc/ipc_service.h>
#include <zephyr/shell/shell.h>
#include <string.h>

LOG_MODULE_REGISTER(host, LOG_LEVEL_INF);

struct payload
{
    unsigned long size;
    char command_string[64];
};

static struct payload remote_command;
static struct payload remote_reply;
static const struct device *ipc0_instance = DEVICE_DT_GET(DT_NODELABEL(ipc0));

static K_SEM_DEFINE(bound_sem, 0, 1);

static void ep_bound(void *priv)
{
    k_sem_give(&bound_sem);
}

static void ep_recv(const void *data, size_t len, void *priv)
{
    memcpy(&remote_reply, data, len);
    k_sem_give(&bound_sem);
}

static struct ipc_ept_cfg ep_cfg = {
    .name = "ep0",
    .cb = {
        .bound = ep_bound,
        .received = ep_recv,
    },
};

// k_sem_init(&bound_sem, 0, 1);

int main(void)
{
    struct ipc_ept ep;
    int ret;

  //  k_sem_give(&bound_sem);

    ret = ipc_service_open_instance(ipc0_instance);
    if ((ret < 0) && (ret != -EALREADY))
    {
        LOG_INF("ipc_service_open_instance() failure");
        return ret;
    }

    ret = ipc_service_register_endpoint(ipc0_instance, &ep, &ep_cfg);
    if (ret < 0)
    {
        LOG_INF("ipc_service_register_endpoint() failure");
        return ret;
    }

  //  LOG_INF("ff1 failure");
    //    k_sem_init(&bound_sem, 0, 1);
//    LOG_INF("FF0 FAILURE", k_sem_take(&bound_sem, K_MSEC(50)));
 //   k_sem_take(&bound_sem, K_FOREVER);
  //  LOG_INF("ff2 failure");
    LOG_INF("ipc service is ready to communicate!");

    strcpy(remote_command.command_string, "AT+IPC_COMMAND\n\r");
    remote_command.size = strlen(remote_command.command_string) + 1;

    while (1)
    {
        ret = ipc_service_send(&ep, &remote_command, sizeof(remote_command));
        LOG_INF("sending AT command: %s to remote CPU", remote_command.command_string);

        if (ret == -ENOMEM)
        {
            /* No space in the buffer. Retry. */
            LOG_WRN("No space in the vring buffer retrying...");
            continue;
        }

     //   k_sem_take(&bound_sem, K_FOREVER);
        LOG_INF("received from remote CPU the response: %s", remote_reply.command_string);
        k_sleep(K_MSEC(1000));
    }
    return 0;
}
```
